## firmware/sdkconfig.defaults
```kconfig
# 目标芯片
CONFIG_IDF_TARGET="esp32s3"

# Flash：模组为 16 MB
CONFIG_ESPTOOLPY_FLASHSIZE_16MB=y
CONFIG_ESPTOOLPY_FLASHMODE_QIO=y
CONFIG_ESPTOOLPY_FLASHFREQ_80M=y

# PSRAM：N16R8 为 8 MB Octal
CONFIG_SPIRAM=y
CONFIG_SPIRAM_MODE_OCT=y
CONFIG_SPIRAM_SPEED_80M=y
CONFIG_SPIRAM_USE_MALLOC=y

# 主频
CONFIG_ESP_DEFAULT_CPU_FREQ_MHZ_240=y

# 分区表：单 APP 大分区，为后续词库音频留出空间
CONFIG_PARTITION_TABLE_SINGLE_APP_LARGE=y

# 日志
CONFIG_LOG_DEFAULT_LEVEL_INFO=y
```
